## drivers/cpuidle/Kconfig
```kconfig
menu "CPU Idle"

config CPU_IDLE
	bool "CPU idle PM support"
	default y if ACPI || PPC_PSERIES
	select CPU_IDLE_GOV_LADDER if (!NO_HZ && !NO_HZ_IDLE) && !CPU_IDLE_GOV_MOBILE
	help
	  CPU idle is a generic framework for supporting software-controlled
	  idle processor power management.  It includes modular cross-platform
	  governors that can be swapped during runtime.

	  If you're using an ACPI-enabled platform, you should say Y here.

if CPU_IDLE

config CPU_IDLE_MULTIPLE_DRIVERS
        bool

config CPU_IDLE_GOV_LADDER
	bool "Ladder governor (for periodic timer tick)"

config CPU_IDLE_GOV_MENU
	bool "Menu governor (for tickless system)"

config CPU_IDLE_GOV_MOBILE
	bool "Mobile governor"
	select IRQ_TIMINGS
	help
	  The mobile governor is based on irq timings measurements and
	  pattern research combined with the next timer. This governor
	  suits very well on embedded systems where the interrupts are
	  grouped on a single core and the power is the priority.

config DT_IDLE_STATES
	bool

menu "ARM CPU Idle Drivers"
depends on ARM || ARM64
source "drivers/cpuidle/Kconfig.arm"
endmenu

menu "MIPS CPU Idle Drivers"
depends on MIPS
source "drivers/cpuidle/Kconfig.mips"
endmenu

menu "POWERPC CPU Idle Drivers"
depends on PPC
source "drivers/cpuidle/Kconfig.powerpc"
endmenu

endif

config ARCH_NEEDS_CPU_IDLE_COUPLED
	def_bool n
endmenu
```

## drivers/gpu/msm/Kconfig
```kconfig
# SPDX-License-Identifier: GPL-2.0-only
config QCOM_KGSL
	tristate "Qualcomm Technologies, Inc. 3D Graphics driver"
	depends on ARCH_QCOM
	depends on QCOM_QFPROM
	select GENERIC_ALLOCATOR
	select FW_LOADER
	select PM_DEVFREQ
	select QCOM_SCM
	select DEVFREQ_GOV_SIMPLE_ONDEMAND
	select DEVFREQ_GOV_PERFORMANCE
	select DEVFREQ_GOV_QCOM_ADRENO_TZ
	select DEVFREQ_GOV_QCOM_GPUBW_MON
	help
	  3D graphics driver for the Adreno family of GPUs from QTI.
	  Required to use hardware accelerated OpenGL, compute and Vulkan
	  on QTI targets. This includes power management, memory management,
	  and scheduling for the Adreno GPUs.

config GPU_INPUT_BOOST
	bool "GPU Input Boost"
	help
	  Boosts the GPU on touchscreen and touchpad input, and allows for
	  boosting on other custom events, mainly which is intended to be for
	  boosting when there is a new frame ready to be rendered to the
	  display. The boost frequencies for this driver should be set so that
	  frame drops are near-zero at the boosted frequencies and power
	  consumption is minimized at said frequency combination.

if GPU_INPUT_BOOST

config INPUT_BOOST_DURATION_MS
	int "Input boost duration"
	default "100"
	help
	  Input boost duration in milliseconds.

config WAKE_BOOST_DURATION_MS
	int "Wake boost duration"
	default "1000"
	help
	  Wake boost duration in milliseconds.

config INPUT_BOOST_LEVEL
	int "GPU boost level"
	default "4"
	help
	  Input boost level for GPU.

endif

config QCOM_ADRENO_DEFAULT_GOVERNOR
	string "devfreq governor for the adreno core"
	default "msm-adreno-tz" if DEVFREQ_GOV_QCOM_ADRENO_TZ
	default "simple_ondemand"
	depends on QCOM_KGSL

config QCOM_KGSL_IOMMU
	bool
	default y if QCOM_KGSL && (MSM_IOMMU || ARM_SMMU)

config CORESIGHT_ADRENO
	bool
	default y if QCOM_KGSL=y && CORESIGHT=y

config QCOM_KGSL_USE_SHMEM
	bool "Enable using shmem for memory allocations"
	depends on QCOM_KGSL
	help
	  Say 'Y' to enable using shmem for memory allocations. If enabled,
	  there will be no support for the memory pools and higher order pages.
	  But using shmem will help in making kgsl pages available for
	  reclaiming.

config QCOM_KGSL_PROCESS_RECLAIM
	bool "Make driver pages available for reclaim"
	depends on QCOM_KGSL && PROCESS_RECLAIM
	select QCOM_KGSL_USE_SHMEM
	help
	  Say 'Y' to make driver pages available for reclaiming. If enabled,
	  shmem will be used for allocation. kgsl would know the process
	  foreground/background activity through the sysfs entry exposed per
	  process. Based on this kgsl can unpin the pages of the process and
	  make those pages available to the Per Process Reclaim (PPR).
```

## techpack/Kconfig
```kconfig
menu "Tech packages"

config TECHPACK_AUDIO_DISABLE
	bool "Disable compilation for audio module"
	default n
	help
	  Say Y here to disable compilation for audio module.
	  Sometimes useful for reducing kernel binary size.

source "techpack/data/Kconfig"

source "techpack/camera-legacy/Kconfig"
source "techpack/camera-legacy-m/Kconfig"
source "techpack/xiaomi-msm8937/Kconfig"
source "techpack/xiaomi-sdm439/Kconfig"
menu "Camera packages"

config TECHPACK_CAMERA_XIAOMI
    bool "Xiaomi camera"
    help
      Xiaomi camera

config TECHPACK_CAMERA_XIAOMI_CAS
    bool "Xiaomi camera CAS"
    help
      Xiaomi camera CAS

config TECHPACK_CAMERA_XIAOMI_TABLET
    bool "Xiaomi camera tablet"
    help
      Xiaomi camera tablet

endmenu

endmenu
```
